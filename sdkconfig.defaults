## sdkconfig.defaults
```kconfig
CONFIG_IDF_TARGET="esp32s3"
CONFIG_ESPTOOLPY_FLASHSIZE_16MB=y
CONFIG_PARTITION_TABLE_CUSTOM=y
CONFIG_PARTITION_TABLE_CUSTOM_FILENAME="partitions.csv"
CONFIG_SPIRAM=y
CONFIG_SPIRAM_MODE_OCT=y
CONFIG_SPIRAM_SPEED_80M=y
CONFIG_SPIRAM_USE_MALLOC=y
CONFIG_BT_ENABLED=y
CONFIG_BT_NIMBLE_ENABLED=y
CONFIG_NETWORK_PROV_NETWORK_TYPE_WIFI=y
CONFIG_ESP_PROTOCOMM_SUPPORT_SECURITY_VERSION_1=y
CONFIG_ESP_PROTOCOMM_SUPPORT_SECURITY_VERSION_0=n
CONFIG_MBEDTLS_CERTIFICATE_BUNDLE=y
CONFIG_MBEDTLS_DEFAULT_MEM_ALLOC=y
CONFIG_ESP_HTTP_CLIENT_ENABLE_HTTPS=y
CONFIG_LV_COLOR_DEPTH_16=y
CONFIG_LV_USE_QRCODE=y
CONFIG_LV_USE_CLIB_MALLOC=y
CONFIG_LV_USE_BUILTIN_MALLOC=n
CONFIG_LV_FONT_FMT_TXT_LARGE=y
CONFIG_LV_USE_SNAPSHOT=y
CONFIG_ESP_CONSOLE_USB_SERIAL_JTAG=y
CONFIG_BSP_LCD_DRAW_BUF_HEIGHT=40
CONFIG_BSP_LCD_DRAW_BUF_DOUBLE=y
```
